## conf/layer.conf
```bitbake
# We have a conf and classes directory, add to BBPATH
BBPATH .= ":${LAYERDIR}"

# We have recipes-* directories, add to BBFILES
BBFILES += "${LAYERDIR}/recipes-*/*/*.bb \
            ${LAYERDIR}/recipes-*/*/*.bbappend"

BBFILE_COLLECTIONS += "meta-dhcom_nbox-testing"
BBFILE_PATTERN_meta-dhcom_nbox-testing = "^${LAYERDIR}/"
BBFILE_PRIORITY_meta-dhcom_nbox-testing = "6"

LAYERDEPENDS_meta-dhcom_nbox-testing = "core"
LAYERSERIES_COMPAT_meta-dhcom_nbox-testing = "thud"
```
